## Yocto_layers/meta-AhmedWafdy/conf/layer.conf
```bitbake
# We have a conf and classes directory, add to BBPATH
BBPATH .= ":${LAYERDIR}"

# We have recipes-* directories, add to BBFILES
BBFILES += "${LAYERDIR}/recipes-*/*/*.bb \
            ${LAYERDIR}/recipes-*/*/*.bbappend"

BBFILE_COLLECTIONS += "meta-AhmedWafdy"
BBFILE_PATTERN_meta-AhmedWafdy = "^${LAYERDIR}/"
BBFILE_PRIORITY_meta-AhmedWafdy = "6"

LAYERDEPENDS_meta-AhmedWafdy = "core"
LAYERSERIES_COMPAT_meta-AhmedWafdy = "dunfell"
```

## Yocto_layers/meta-wafdunix/conf/layer.conf
```bitbake
# We have a conf and classes directory, add to BBPATH
BBPATH .= ":${LAYERDIR}"

# We have recipes-* directories, add to BBFILES
BBFILES += "${LAYERDIR}/recipes-*/*/*.bb \
            ${LAYERDIR}/recipes-*/*/*.bbappend"

BBFILE_COLLECTIONS += "meta-wafdunix"
BBFILE_PATTERN_meta-wafdunix = "^${LAYERDIR}/"
BBFILE_PRIORITY_meta-wafdunix = "6"

LAYERDEPENDS_meta-wafdunix = "core"
LAYERSERIES_COMPAT_meta-wafdunix = "dunfell"
```
